## CMakeLists.txt
```
# Enable sysbuild
cmake_minimum_required(VERSION 3.21)
find_package(Zephyr HINTS $ENV{ZEPHYR_BASE})
project(power_meter_cleat)

# Ensure HCI_RPMsg is built as a child image for Bluetooth communication
if (CONFIG_BT_RPMSG)
    set(BOARD_ROOT ${CMAKE_CURRENT_SOURCE_DIR})
endif()

# Add your application's sources
FILE(GLOB app_sources src/*.c)
target_sources(app PRIVATE ${app_sources})
target_include_directories(app PRIVATE include)
```

## west.yml
```
manifest:
  remotes:
    - name: zephyrproject
      url-base: https://github.com/zephyrproject-rtos
  projects:
    - name: hci_rpmsg
      remote: zephyrproject
      revision: main
```

## prj.conf
```kconfig
# Bluetooth configuration
CONFIG_BT=y
CONFIG_BT_PERIPHERAL=y
CONFIG_BT_DEVICE_NAME="Cycling Power Meter"
CONFIG_BT_DEVICE_APPEARANCE=1152

# Enable security features (optional, depending on your application)
CONFIG_BT_SMP=y
CONFIG_BT_PRIVACY=y

# Flash and settings
CONFIG_FLASH=y
CONFIG_FLASH_MAP=y
CONFIG_NVS=y
CONFIG_SETTINGS=y
CONFIG_BT_SETTINGS=y
CONFIG_BT_KEYS_OVERWRITE_OLDEST=y
CONFIG_SYSTEM_WORKQUEUE_STACK_SIZE=2048

# Optional: Enable the Battery Service if you want to add battery notifications
# CONFIG_BT_BAS=y

# Logging
CONFIG_LOG=y
CONFIG_LOG_BUFFER_SIZE=2048
CONFIG_LOG_BACKEND_UART=y
CONFIG_LOG_PRINTK=y
CONFIG_LOG_MODE_DEFERRED=n

# Enable UART for console output
CONFIG_SERIAL=y
CONFIG_UART_CONSOLE=y

# Enable the Analog-Digital Converter API and driver
CONFIG_ADC=y

# Multithreading (mutexes, semaphores, ...)
CONFIG_MULTITHREADING=y

CONFIG_GPIO=y

CONFIG_DK_LIBRARY=y
```

## boards/nrf5340dk_nrf5340_cpuapp_ns.overlay
```dts
/*
 * SPDX-License-Identifier: Apache-2.0
 *
 * Copyright (c) 2022 Nordic Semiconductor ASA
 */


 /* create a node and set its io-channels to the ADC channel 0 */
 // you could specify multiple channels, separated by comma (Ex: io-channels = <&adc0 1>, <&adc0 3>;
 / {
	zephyr,user {
		io-channels = <&adc 0>;
	};
};

/* Configure the ADC channel parameters */
&adc {
	#address-cells = <1>;
	#size-cells = <0>;
	status = "okay";
	channel@0 {  // referencing channel 0 of the ADC
		reg = <0>;
		zephyr,gain = "ADC_GAIN_1_6";  // reading attenuated by (x 1/6), could be changed to 1/5, 1/4, 1/3, 1/2, 1, 2 or 4
		zephyr,reference = "ADC_REF_INTERNAL";  // use internal +-0.6
		zephyr,acquisition-time = <ADC_ACQ_TIME_DEFAULT>;  // default = 10 us
		zephyr,input-positive = <NRF_SAADC_AIN0>; /* Single ended input set to input pin AIN0, which is P0.04 for nRF53xx */
		zephyr,resolution = <12>;  // resolution: 12 bits
	};
};
```

## src/main.c
```c
// basics
#include <zephyr/types.h>
#include <stdlib.h>
#include <stddef.h>
#include <string.h>
#include <errno.h>
#include <math.h>
#include <zephyr/sys/printk.h>
#include <zephyr/logging/log.h>

// inputs
#include <zephyr/kernel.h>
#include <zephyr/device.h>
#include <zephyr/devicetree.h>
#include <zephyr/drivers/gpio.h>

// bluetooth
#include <zephyr/bluetooth/bluetooth.h>
#include <zephyr/bluetooth/hci.h>
#include <zephyr/bluetooth/conn.h>
#include <zephyr/bluetooth/uuid.h>
#include <zephyr/bluetooth/gatt.h>
#include <zephyr/settings/settings.h>

// Zephyr ADC API
#include <zephyr/drivers/adc.h>

#include <dk_buttons_and_leds.h>

#define RUN_STATUS_LED             DK_LED1
#define CENTRAL_CON_STATUS_LED	   DK_LED2
#define PERIPHERAL_CONN_STATUS_LED DK_LED3


#define PIN 4

//------------------------- DEFINE ----------------------------------------------
// #define BT_UUID_CPS BT_UUID_DECLARE_16(0x1818)  // CPS 16-bit UUID
// #define BT_UUID_CPS_MEASUREMENT BT_UUID_DECLARE_16(0x2A63)  // CPS Measurement
#define SERVICE_UUID BT_UUID_DECLARE_16(0x1818)
#define CHAR_UUID    BT_UUID_DECLARE_16(0x2A63)

/* KALMAN FILTER: GLOBAL DEFINES FOR EASY ALGORITHM TUNING */
#define CALIB_COEFF 0.00216    // Calibration coeff for mV -> W conversion
#define KALMAN_X 0    // Initial state estimate (W)
#define KALMAN_P 1.0    // Initial covariance estimate
#define KALMAN_Q 0.01    // Process noise covariance
#define KALMAN_R 1.0    // Measurement noise covariance

// Bluetooth threads
#define BLE_THREAD_STACK_SIZE 1024
#define BLE_THREAD_PRIORITY 3

// ADC threads
#define ADC_THREAD_STACK_SIZE 1024
#define ADC_THREAD_PRIORITY 1 // high priority to ensure consistent readings

// Cadence threads
#define CADENCE_THREAD_STACK_SIZE 1024
#define CADENCE_THREAD_PRIORITY -1 // high priority to ensure consistent readings

// TODO: Better comment
#define DEBOUNCE_DELAY_MS 200

/* SW0_NODE is the devicetree node identifier for the node with alias "sw0"= button 0 */
#define SW0_NODE DT_ALIAS(sw0)

//---------------------- K_DEFINE ----------------------------------------------

// Thread stack and priority definitions for ADC
K_THREAD_STACK_DEFINE(adc_thread_stack, ADC_THREAD_STACK_SIZE);

// Thread stack and priority definitions for BLE notification
K_THREAD_STACK_DEFINE(ble_thread_stack, BLE_THREAD_STACK_SIZE);

// Thread stack and priority definitions for Cadence
K_THREAD_STACK_DEFINE(cadence_thread_stack, CADENCE_THREAD_STACK_SIZE);
// K_THREAD_DEFINE(cadence_thread, 1024, cadence_entry, NULL, NULL, NULL, -1, 0, 0);

// Semaphore to signal the thread
K_SEM_DEFINE(adc_semaphore, 0, 1);

K_SEM_DEFINE(cadence_semaphore, 0, 1);


//---------------------- STRUCTS -------------------------------------------------

static const struct gpio_dt_spec button0 = GPIO_DT_SPEC_GET(SW0_NODE, gpios);
static const struct gpio_dt_spec signal_pin = {
    .dt_flags = GPIO_ACTIVE_HIGH,
    .pin = 5,
    .port = DEVICE_DT_GET(DT_NODELABEL(gpio0))
};

/* Advertising Data (Include CPS UUID) */
static const struct bt_data ad[] = {
    BT_DATA_BYTES(BT_DATA_FLAGS, (BT_LE_AD_GENERAL | BT_LE_AD_NO_BREDR)),
    BT_DATA_BYTES(BT_DATA_UUID16_ALL, BT_UUID_16_ENCODE(0x1818)),
};

/* Define a variable of type adc_dt_spec for each channel */
static const struct adc_dt_spec adc_channel = ADC_DT_SPEC_GET(DT_PATH(zephyr_user));

/* Define a variable of type adc_sequence and a buffer of type uint16_t to specify where the samples are to be written */
int16_t buf;
struct adc_sequence sequence = {
    .buffer = &buf,
    /* buffer size in bytes, not number of samples */
    .buffer_size = sizeof(buf),
    // Optional
    .calibrate = true,
};

//Kalman filter
typedef struct {
    double x;  // State estimate
    double P;  // Estimate covariance
    double Q;  // Process noise covariance
    double R;  // Measurement noise covariance
    double K;  // Kalman gain
} KalmanFilter;

// Thread stack and priority definitions for adc
struct k_thread adc_thread_data;
k_tid_t adc_thread_id;

// Thread stack and priority definitions for BLE notification
struct k_thread ble_thread_data;
k_tid_t ble_thread_id;

// Thread stack and priority definitions for cadence
struct k_thread cadence_thread_data;
k_tid_t cadence_thread_id;

/* Define a variable of type static struct gpio_callback */
static struct gpio_callback button_cb_data;

/* GPIO callback structure for interrupt signal*/
static struct gpio_callback interrupt_cb_data;

static struct k_timer debounce_timer;

//TODO: Find a place for this
volatile bool debounce_flag = false;

//-------------------------- ??? ---------------------------------------------------

//TODO: Find a place for this
/* Enable logs */
LOG_MODULE_REGISTER(cycling_power_meter, LOG_LEVEL_DBG);

//-------------------------- FUNCTION DECLARATIONS ----------------------------------

//BT service setup
static void ccc_cfg_changed(const struct bt_gatt_attr *attr, uint16_t value);
static ssize_t read_cycling_power(struct bt_conn *conn, const struct bt_gatt_attr *attr,
                                  void *buf, uint16_t len, uint16_t offset);
static void send_cycling_power_notification(void);
void ble_notification_thread(void *arg1, void *arg2, void *arg3);

// BT connection setup
static void connected(struct bt_conn *conn, uint8_t err);
static void disconnected(struct bt_conn *conn, uint8_t reason);
static void bt_ready(void);

// ADC voltage reading and conversion
int read_voltage(void);
void voltage_to_power(int voltage_mv);

// Kalman filtering
void kalman_init(KalmanFilter* kf, double init_x, double init_P, double Q, double R);
void kalman_predict(KalmanFilter* kf);
void kalman_update(KalmanFilter* kf, double measurement);
void adc_thread(void *arg1, void *arg2, void *arg3);

// Interrupt configs
void debounce_timer_handler(struct k_timer *timer_id);
void button_pressed(const struct device *dev, struct gpio_callback *cb, uint32_t pins);
void interrupt_handler(const struct device *dev, struct gpio_callback *cb, uint32_t pins);
void cadence_entry(void *arg1, void *arg2, void *arg3);


const struct device *adc_dev;

#include <hal/nrf_saadc.h>
#define ADC_DEVICE_NAME DT_ADC_0_NAME
#define ADC_RESOLUTION 12
#define ADC_GAIN ADC_GAIN_1_6
#define ADC_REFERENCE ADC_REF_INTERNAL
#define ADC_ACQUISITION_TIME ADC_ACQ_TIME(ADC_ACQ_TIME_MICROSECONDS, 40)
#define ADC_1ST_CHANNEL_ID 0
#define ADC_1ST_CHANNEL_INPUT NRF_SAADC_INPUT_AIN0 //AIN0

static const struct adc_channel_cfg m_1st_channel_cfg = {
    .gain = ADC_GAIN,
    .reference = ADC_REFERENCE,
    .acquisition_time = ADC_ACQUISITION_TIME,
    .channel_id = ADC_1ST_CHANNEL_ID,
#if defined(CONFIG_ADC_CONFIGURABLE_INPUTS)
    .input_positive = ADC_1ST_CHANNEL_INPUT,
#endif
};

static const struct adc_channel_cfg m_disabled_channel_cfg = {
    .gain = ADC_GAIN,
    .reference = ADC_REFERENCE,
    .acquisition_time = ADC_ACQUISITION_TIME,
    .channel_id = ADC_1ST_CHANNEL_ID,
    .input_positive = NRF_SAADC_INPUT_DISABLED,
};


// --------------------------------- MAIN ------------------------------------------------
int main(void) {
    int err;
    
	err = dk_leds_init();
	if (err) {
		printk("LEDs init failed (err %d)\n", err);
	}
    // -------------- THREADS --------------------
    // Initialize semaphore
    k_sem_init(&adc_semaphore, 0, 1);

    // Create ADC reading thread
    adc_thread_id = k_thread_create(&adc_thread_data, adc_thread_stack,
                                    K_THREAD_STACK_SIZEOF(adc_thread_stack),
                                    adc_thread,
                                    NULL, NULL, NULL,
                                    ADC_THREAD_PRIORITY, 0, K_NO_WAIT);
                                    
    // Create BLE notification thread
    ble_thread_id = k_thread_create(&ble_thread_data, ble_thread_stack,
                                    K_THREAD_STACK_SIZEOF(ble_thread_stack),
                                    ble_notification_thread,
                                    NULL, NULL, NULL,
                                    BLE_THREAD_PRIORITY, 0, K_NO_WAIT);

    cadence_thread_id = k_thread_create(&cadence_thread_data, cadence_thread_stack,
                                        K_THREAD_STACK_SIZEOF(cadence_thread_stack),
                                         cadence_entry,
                                         NULL, NULL, NULL,
                                         CADENCE_THREAD_STACK_SIZE, 0, K_NO_WAIT);

    /* -------------- BLUETOOTH -----------------*/
    // srand(k_uptime_get());

    err = bt_enable(NULL);
    if (err) {
        LOG_ERR("Bluetooth init failed (err %d)", err);
        return -1;
    }

    /* Load settings, such as Bluetooth identity address */
    err = settings_load();
    if (err) {
        LOG_ERR("Settings load failed (err %d)", err);
        return -1;
    }
    else
    dk_set_led(PERIPHERAL_CONN_STATUS_LED, 1);

    bt_ready();

    /* -------------- ADC -----------------*/


    /* Validate that the ADC peripheral (SAADC) is ready */
    if (!adc_is_ready_dt(&adc_channel)) {
        LOG_ERR("ADC controller device %s not ready", adc_channel.dev->name);
        return -1;
    }

    LOG_INF("ADC peripheral ready");

    /*  Setup the ADC channel */
    err = adc_channel_setup_dt(&adc_channel);
    if (err < 0) {
        LOG_ERR("Could not setup channel #%d (%d)", 0, err);
        return -1;
    }

    LOG_INF("ADC channel set up");

    /* Initialize the ADC sequence */
    err = adc_sequence_init_dt(&adc_channel, &sequence);
    if (err < 0) {
        LOG_ERR("Could not initialize sequence");
        return -1;
    }

    LOG_INF("ADC sequence initialized");

    /* -------------- INTERRUPT -----------------*/
    /* Init button for interrupt */
    if (!device_is_ready(button0.port)) {
        return -1;
    }

    LOG_INF("Button ready");

    /* Configure button as input */
    err = gpio_pin_configure_dt(&button0, GPIO_INPUT);
    if (err < 0) {
        return -1;
    }

    /* Configure the interrupt on the button's pin */
    err = gpio_pin_interrupt_configure_dt(&button0, GPIO_INT_EDGE_TO_ACTIVE);

    /* Initialize the static struct gpio_callback variable   */
    gpio_init_callback(&button_cb_data, button_pressed, BIT(button0.pin));

    /* Add the callback function by calling gpio_add_callback()   */
    gpio_add_callback(button0.port, &button_cb_data);
    
    /* Initialize the timer */
    k_timer_init(&debounce_timer, debounce_timer_handler, NULL);

    LOG_INF("GPIO interrupt routine set up");
    
    // Rising edge signal triggered interrupt
    
    if (!device_is_ready(signal_pin.port)) {
        LOG_ERR("Error: GPIO device %s is not ready", signal_pin.port->name);
        return -1;
    }

    /* Configure P0.05 as input with a rising edge interrupt */
    err = gpio_pin_configure_dt(&signal_pin, GPIO_INPUT | GPIO_ACTIVE_HIGH);
    if (err < 0) {
        LOG_ERR("Error configuring GPIO pin");
        return -1;
    }

    err = gpio_pin_interrupt_configure_dt(&signal_pin, GPIO_INT_EDGE_RISING);
    if (err < 0) {
        LOG_ERR("Error configuring GPIO interrupt");
        return -1;
    }

    /* Initialize and add GPIO callback */
    gpio_init_callback(&interrupt_cb_data, interrupt_handler, BIT(signal_pin.pin));
    gpio_add_callback(signal_pin.port, &interrupt_cb_data);

    LOG_INF("Interrupt on P0.05 configured for rising edge");

    LOG_INF("Device completely set up and functional");

    return 0;
}

//------------------------- BT SERVICE SETUP ----------------------------------------
static uint8_t cycling_power_value[7];  // will be secured by mutex
static bool notifications_enabled = false;

/* Mutex for cycling_power_value and cadence */
K_MUTEX_DEFINE(power_val_mutex);  // start value 0, limit 1, same as: K_SEM_DEFINE(power_val_sem, 0, 1);
K_MUTEX_DEFINE(cadence_val_mutex);
K_MUTEX_DEFINE(last_press_time_mutex);

/* CCC configuration change handler (for notifications) */
static void ccc_cfg_changed(const struct bt_gatt_attr *attr, uint16_t value) {
    notifications_enabled = (value == BT_GATT_CCC_NOTIFY);
    LOG_INF("Notifications %s", notifications_enabled ? "enabled" : "disabled");
}

/* Read function for CPS (can be extended as needed) */
static ssize_t read_cycling_power(struct bt_conn *conn, const struct bt_gatt_attr *attr,
                                  void *buf, uint16_t len, uint16_t offset) {
    const uint8_t *value = attr->user_data;
    return bt_gatt_attr_read(conn, attr, buf, len, offset, value, sizeof(cycling_power_value));
}

// TODO: Find a place for this
/* Define the Cycling Power Service and Characteristics */
BT_GATT_SERVICE_DEFINE(cps_svc,
    BT_GATT_PRIMARY_SERVICE(SERVICE_UUID),
    BT_GATT_CHARACTERISTIC(CHAR_UUID, BT_GATT_CHRC_NOTIFY,
                           BT_GATT_PERM_READ, read_cycling_power, NULL, cycling_power_value),
    BT_GATT_CCC(ccc_cfg_changed, BT_GATT_PERM_READ | BT_GATT_PERM_WRITE),  // CCC for notifications
);

/*BT_GATT_CHARACTERISTIC(&custom_uuid.uuid,
    BT_GATT_CHRC_NOTIFY,
    BT_GATT_PERM_NONE,
    NULL, NULL, NULL),
BT_GATT_CCC(NULL, BT_GATT_PERM_READ | BT_GATT_PERM_WRITE),*/

/* Function to send cycling power notifications */
static void send_cycling_power_notification(void) {
    if (notifications_enabled) {
        if (k_mutex_lock(&power_val_mutex, K_MSEC(50)) != 0) {
            LOG_ERR("Input data not available!");
        } else {
            bt_gatt_notify(NULL, &cps_svc.attrs[1], cycling_power_value, sizeof(cycling_power_value));
            k_mutex_unlock(&power_val_mutex);
        }
    }
}

void ble_notification_thread(void *arg1, void *arg2, void *arg3) {
    int blink_status = 0;
    while (1) {
        // Sleep for 1 second or adjust the interval as needed for power saving
        k_sleep(K_SECONDS(1));

        // Send BLE notification
        send_cycling_power_notification();
        
		dk_set_led(RUN_STATUS_LED, (++blink_status) % 2);
    }
}

//------------------------------ BT CONNECTION SETUP ----------------------------------------------

/* Callback function for Bluetooth connection */
static void connected(struct bt_conn *conn, uint8_t err) {
    if (err) {
        LOG_ERR("Connection failed (err 0x%02x)", err);
    } else {
        LOG_INF("Connected");
        dk_set_led(CENTRAL_CON_STATUS_LED, 1);
    }
}

/* Callback function for Bluetooth disconnection */
static void disconnected(struct bt_conn *conn, uint8_t reason) {
    LOG_INF("Disconnected (reason 0x%02x)", reason);
    dk_set_led(CENTRAL_CON_STATUS_LED, 0);
}

//TODO: Find a place for this
/* Register connection callbacks */
BT_CONN_CB_DEFINE(conn_callbacks) = {
    .connected = connected,
    .disconnected = disconnected,
};

/* Bluetooth ready callback */
static void bt_ready(void) {
    int err;

    LOG_INF("Bluetooth initialized");

    err = bt_le_adv_start(BT_LE_ADV_CONN, ad, ARRAY_SIZE(ad), NULL, 0);
    if (err) {
        LOG_ERR("Advertising failed to start (err %d)", err);
        return;
    }

    LOG_INF("Advertising successfully started");
}

// --------------------------------- ADC VOLTAGE READING AND CONVERSION -------------------------------------------------

/* Read voltage from input pin and convert it to digital signal */
int read_voltage(void) {
    int err;
    int val_mv;
    uint32_t count = 0;

    LOG_INF("Reading voltage");
    
    err = adc_read(adc_channel.dev, &sequence);
    
    if (err < 0) {
        LOG_ERR("Failed to read ADC: %d", err);
    }

    if (err < 0) {
        LOG_ERR("Failed to read ADC after retries, %d", err);
        return err;
    }

    val_mv = (int)buf;
    LOG_INF("ADC reading[%u]: %s, channel %d: Raw: %d", count++, adc_channel.dev->name,
            adc_channel.channel_id, val_mv);

    /* Convert raw value to mV */
    err = adc_raw_to_millivolts_dt(&adc_channel, &val_mv);
    /* Conversion to mV may not be supported, skip if not */
    if (err < 0) {
        LOG_WRN(" (value in mV not available)");
    } else {
        LOG_INF(" = %d mV", val_mv);
    }
    return val_mv;
}

// TODO: Figure where this belongs
static uint16_t global_cadence = 0; 

// Convert mV to W
void voltage_to_power(int voltage_mv) {
    uint16_t cadence;

    if (k_mutex_lock(&cadence_val_mutex, K_MSEC(50)) == 0) {
        cadence = global_cadence;  // Copy the global cadence while holding the mutex
        k_mutex_unlock(&cadence_val_mutex);
    } else {
        LOG_ERR("Failed to lock mutex for reading cadence value");
        return;
    }

    
    double mv_double = 0.0;
    double cadence_double = 0.0;
    double power_double = 0.0;
    mv_double = voltage_mv;
    cadence_double = cadence;
    power_double = mv_double * cadence_double * CALIB_COEFF;
    uint16_t power = power_double; // voltage_mv * cadence * CALIB_COEFF;

    if (k_mutex_lock(&power_val_mutex, K_MSEC(50)) == 0) {
        cycling_power_value[0] = 0x00;
        cycling_power_value[1] = (uint8_t)(power & 0xFF);
        cycling_power_value[2] = (uint8_t)((power >> 8) & 0xFF);
        cycling_power_value[3] = (uint8_t)(cadence & 0xFF);
        cycling_power_value[4] = (uint8_t)((cadence >> 8) & 0xFF);
        cycling_power_value[5] = (uint8_t)(voltage_mv & 0xFF);
        cycling_power_value[6] = (uint8_t)((voltage_mv >> 8) & 0xFF);
        k_mutex_unlock(&power_val_mutex);
    } else {
        LOG_ERR("Failed to lock mutex for updating power value");
    }
}

//------------------------------ Kalman Filtering -------------------------------------

void kalman_init(KalmanFilter* kf, double init_x, double init_P, double Q, double R) {
    kf->x = init_x;
    kf->P = init_P;
    kf->Q = Q;
    kf->R = R;
}

void kalman_predict(KalmanFilter* kf) {
    kf->P += kf->Q;
}

void kalman_update(KalmanFilter* kf, double measurement) {
    kf->K = kf->P / (kf->P + kf->R);
    kf->x += kf->K * (measurement - kf->x);
    kf->P *= (1 - kf->K);
}

#define BUFFER_SIZE 1
static int16_t m_sample_buffer[BUFFER_SIZE];

const struct adc_sequence_options sequence_opts = {
	.interval_us = 0,
	.callback = NULL,
	.user_data = NULL,
	.extra_samplings = 0,
};

static int32_t sensor_init(void)
{

	printk("nRF53 SAADC sampling AIN0 (P0.04)\n");
	adc_dev = device_get_binding("ADC_0");
	if (!adc_channel.dev) {
		printk("device_get_binding ADC_0 failed\n");
	}
	int err = adc_channel_setup(adc_channel.dev, &m_1st_channel_cfg);
	if (err) {
		printk("Error in adc setup: %d\n", err);
	}
}

void disable_adc()
{
	int ret;

	adc_dev = device_get_binding("ADC_0");
	if (!adc_channel.dev) {
		printk("device_get_binding ADC_0 failed\n");
	}

	int err = adc_channel_setup(adc_channel.dev, &m_disabled_channel_cfg);

	if (err) {
		printk("Error in adc setup: %d\n", err);
	}

	int32_t adc_vref = adc_ref_internal(adc_channel.dev);

	const struct adc_sequence sequence = {
		.options = &sequence_opts,
		.channels = BIT(ADC_1ST_CHANNEL_ID),
		.buffer = m_sample_buffer,
		.buffer_size = sizeof(m_sample_buffer),
		.resolution = ADC_RESOLUTION,
		.oversampling = 4	// takes 8 samples and saves the average value
	};
}

void adc_thread(void *arg1, void *arg2, void *arg3) {
    KalmanFilter kf;
    kalman_init(&kf, KALMAN_X, KALMAN_P, KALMAN_Q, KALMAN_R);  // Initialize the Kalman filter with macros
    /*struct device *dev;
	dev = device_get_binding("GPIO_0");*/
    const struct device *dev = DEVICE_DT_GET(DT_NODELABEL(gpio0));

    while (1) {
        // Wait for the button press signal
        k_sem_take(&adc_semaphore, K_FOREVER);

        // Perform ADC reading
        int voltage_mv = read_voltage();
        if (voltage_mv < 0) {
            voltage_mv = 0;  // convert negative voltage readings to 0
        }

        // Convert voltage to power
        voltage_to_power(voltage_mv);

        // zero the energy storage
        adc_channel_setup(adc_channel.dev, &m_disabled_channel_cfg);
        k_sleep(K_MSEC(1)); // Varmistetaan että ADC irrottaa pinniresurssin
        gpio_pin_configure(dev, PIN, GPIO_OUTPUT_LOW);
        k_sleep(K_MSEC(200));	
        gpio_pin_configure(dev, PIN, GPIO_DISCONNECTED);
        adc_channel_setup(adc_channel.dev, &m_1st_channel_cfg);

       /* disable_adc();
        gpio_pin_configure(adc_channel.dev, PIN, GPIO_OUTPUT_LOW);
        k_sleep(K_MSEC(180));	
        gpio_pin_configure(adc_channel.dev, PIN, GPIO_DISCONNECTED);
        //SAADC_TASKS_CALIBRATEOFFSET_TASKS_CALIBRATEOFFSET_Trigger;
        k_sleep(K_MSEC(20));
        sensor_init();*/

        // Apply Kalman filter to the power reading
        if (k_mutex_lock(&power_val_mutex, K_MSEC(50)) == 0) {
            // Use current power value from `cycling_power_value` to get a raw power estimate
            uint16_t raw_power = (cycling_power_value[2] << 8) | cycling_power_value[1];
            
            // Predict and update steps for Kalman filter
            kalman_predict(&kf);
            kalman_update(&kf, (double)raw_power);
            
            // Store the filtered power estimate back in `cycling_power_value`
            uint16_t filtered_power = (uint16_t)round(kf.x);
            cycling_power_value[1] = (uint8_t)(filtered_power & 0xFF);
            cycling_power_value[2] = (uint8_t)((filtered_power >> 8) & 0xFF);

            k_mutex_unlock(&power_val_mutex);
        } else {
            LOG_ERR("Failed to lock mutex for updating power value");
        }
    }
}


// --------------------------------- INTERRUPT CONFIGS -----------------------------------------------

/* Timer Callback: Reset debounce flag */
void debounce_timer_handler(struct k_timer *timer_id) {
    debounce_flag = false;
}

// TODO: Move this?
static uint64_t last_button_time = 0;

void button_pressed(const struct device *dev, struct gpio_callback *cb, uint32_t pins) {
    if (debounce_flag) {
        // Ignore if still debouncing
        return;
    }

    debounce_flag = true;
    k_timer_start(&debounce_timer, K_MSEC(DEBOUNCE_DELAY_MS), K_NO_WAIT);
    
    LOG_INF("Rising edge detected on P0.05");
    // Signal the ADC thread to start
    k_sem_give(&cadence_semaphore);
    k_sem_give(&adc_semaphore);
}

/* Interrupt handler function */
void interrupt_handler(const struct device *dev, struct gpio_callback *cb, uint32_t pins) {
    if (debounce_flag) {
        // Ignore if still debouncing
        return;
    }

    debounce_flag = true;
    k_timer_start(&debounce_timer, K_MSEC(DEBOUNCE_DELAY_MS), K_NO_WAIT);
    
    LOG_INF("Rising edge detected on P0.05");
    // Signal the ADC thread to start
    k_sem_give(&cadence_semaphore);
    k_sem_give(&adc_semaphore);
}

void cadence_entry(void *arg1, void *arg2, void *arg3)
{
    while(1){
        k_sem_take(&cadence_semaphore, K_FOREVER);
        uint64_t current_time = k_uptime_get();

        // Calculate cadence (RPM) based on time since last button press
        if (last_button_time != 0) {
            uint64_t delta_t = current_time - last_button_time;

            if (delta_t > 0) {
                uint16_t calculated_cadence = (60000 / delta_t);  // Calculating cadence (ms to min conversion)

                // Lock the cadence mutex before updating the global cadence
                if (k_mutex_lock(&cadence_val_mutex, K_MSEC(50)) == 0) {
                    global_cadence = calculated_cadence;
                    LOG_INF("Calculated Cadence: %d RPM", global_cadence);
                    k_mutex_unlock(&cadence_val_mutex);
                } else {
                    LOG_ERR("Failed to lock mutex for cadence update");
                }
            }
        }
        // Update the last button press time
        last_button_time = current_time;
    }
}
```

## inc/algorithms.h
```c
#ifndef ALGORITHMS_H
#define ALGORITHMS_H

// VARIABLES
/* adc_dt_spec for each channel */
static const struct adc_dt_spec adc_channel;

/* adc_sequence and a buffer of type uint16_t to specify where the samples are to be written */
extern struct adc_sequence sequence;

// FUNCTIONS
int read_voltage(void);
void voltage_to_power(int voltage_mv);


#endif
```

## inc/defines.h
```c
#ifndef DEFINES_H
#define DEFINES_H

// basics
#include <zephyr/types.h>
#include <stdlib.h>
#include <stddef.h>
#include <string.h>
#include <errno.h>
#include <math.h>
#include <zephyr/sys/printk.h>
#include <zephyr/logging/log.h>

// inputs
#include <zephyr/kernel.h>

/* ------------------------- GLOBALS -------------------------- */

/* KALMAN FILTER: GLOBAL DEFINES FOR EASY ALGORITHM TUNING */
#define CALIB_COEFF 0.00216    // Calibration coeff for mV -> W conversion
#define KALMAN_X 0    // Initial state estimate (W)
#define KALMAN_P 1.0    // Initial covariance estimate
#define KALMAN_Q 0.01    // Process noise covariance
#define KALMAN_R 1.0    // Measurement noise covariance

static uint16_t global_cadence=0;
static uint8_t cycling_power_value[5];

#endif
```

## include/algorithms.h
```c
#ifndef ALGORITHMS_H
#define ALGORITHMS_H

#include <zephyr/types.h>

/* Define a variable of type adc_sequence and a buffer of type uint16_t to specify where the samples are to be written */
int16_t buf;
static uint16_t global_cadence = 0; 

static const struct adc_dt_spec adc_channel = ADC_DT_SPEC_GET(DT_PATH(zephyr_user));

struct adc_sequence sequence = {
    .buffer = &buf,
    /* buffer size in bytes, not number of samples */
    .buffer_size = sizeof(buf),
    // Optional
    .calibrate = true,
};

int read_voltage(void);
void voltage_to_power(int voltage_mv);

#endif
```

## src/algorithms.c
```c
#include "../include/algorithms.h"

// basics
#include <zephyr/types.h>
#include <stdlib.h>
#include <stddef.h>
#include <string.h>
#include <errno.h>
#include <math.h>
#include <zephyr/sys/printk.h>
#include <zephyr/logging/log.h>

// inputs
#include <zephyr/kernel.h>
#include <zephyr/device.h>
#include <zephyr/devicetree.h>
#include <zephyr/drivers/gpio.h>

// bluetooth
#include <zephyr/bluetooth/bluetooth.h>
#include <zephyr/bluetooth/hci.h>
#include <zephyr/bluetooth/conn.h>
#include <zephyr/bluetooth/uuid.h>
#include <zephyr/bluetooth/gatt.h>
#include <zephyr/settings/settings.h>

// Zephyr ADC API
#include <zephyr/drivers/adc.h>

// --------------------------------- ADC VOLTAGE READING AND CONVERSION -------------------------------------------------
/* Define a variable of type adc_dt_spec for each channel */
static const struct adc_dt_spec adc_channel = ADC_DT_SPEC_GET(DT_PATH(zephyr_user));

/* Define a variable of type adc_sequence and a buffer of type uint16_t to specify where the samples are to be written */
int16_t buf;
struct adc_sequence sequence = {
    .buffer = &buf,
    /* buffer size in bytes, not number of samples */
    .buffer_size = sizeof(buf),
    // Optional
    //.calibrate = true,
};

/* Read voltage from input pin and convert it to digital signal */
int read_voltage(void) {
    int err;
    int val_mv;
    uint32_t count = 0;

    LOG_INF("Reading voltage");
    
    err = adc_read(adc_channel.dev, &sequence);
    
    if (err < 0) {
        LOG_ERR("Failed to read ADC: %d", err);
    }

    if (err < 0) {
        LOG_ERR("Failed to read ADC after retries, %d", err);
        return err;
    }

    val_mv = (int)buf;
    LOG_INF("ADC reading[%u]: %s, channel %d: Raw: %d", count++, adc_channel.dev->name,
            adc_channel.channel_id, val_mv);

    /* Convert raw value to mV */
    err = adc_raw_to_millivolts_dt(&adc_channel, &val_mv);
    /* Conversion to mV may not be supported, skip if not */
    if (err < 0) {
        LOG_WRN(" (value in mV not available)");
    } else {
        LOG_INF(" = %d mV", val_mv);
    }
    return val_mv;
}

static uint16_t global_cadence = 0; 
// Convert mV to W
void voltage_to_power(int voltage_mv) {
    uint16_t cadence;

    if (k_mutex_lock(&cadence_val_mutex, K_MSEC(50)) == 0) {
        cadence = global_cadence;  // Copy the global cadence while holding the mutex
        k_mutex_unlock(&cadence_val_mutex);
    } else {
        LOG_ERR("Failed to lock mutex for reading cadence value");
        return;
    }
    uint16_t power = voltage_mv * cadence * CALIB_COEFF;

    if (k_mutex_lock(&power_val_mutex, K_MSEC(50)) == 0) {
        cycling_power_value[0] = 0x00;
        cycling_power_value[1] = (uint8_t)(power & 0xFF);
        cycling_power_value[2] = (uint8_t)((power >> 8) & 0xFF);
        cycling_power_value[3] = (uint8_t)(cadence & 0xFF);
        cycling_power_value[4] = (uint8_t)((cadence >> 8) & 0xFF);
        k_mutex_unlock(&power_val_mutex);
    } else {
        LOG_ERR("Failed to lock mutex for updating power value");
    }
}
```
